/*
YFR_sub_code_1
各種データの取得を行い、ログ記録とインパネ表示を行う
取得データ
・制御状態
・速度
・モーター相電圧
・モーター相電流
・異常信号
・冷却水温度
・加速度
*/
#include <OneWire.h>
#include <DallasTemperature.h>
#include <Adafruit_Sensor.h>
#include <Adafruit_ADXL345_U.h>
#include <mcp_can.h>
#include <SPI.h>
#include <SD.h>
#include <Wire.h>
#include <Adafruit_GFX.h>
#include <Adafruit_SSD1306.h>
#include <String.h>

#define PI 3.14           //演習率
#define gear 10           //ギア比
#define tiya 0.33         //タイヤ直径(13インチ)[m]
#define ONE_WIRE_BUS 4    //データを取得するピン番号
#define SENSER_BIT 10     //計測精度を設定するbit数
#define SCREEN_WIDTH 128  // OLED display width, in pixels
#define SCREEN_HEIGHT 64  // OLED display height, in pixels
#define BMP_WIDTH 128     //ロゴ幅
#define BMP_HEIGHT 57     //ロゴ高さ

MCP_CAN CAN(9);  //Can通信

File myFile;
char fileName_can[20];  // ファイル名用の文字列バッファ
char fileName_tem[20];  // ファイル名用の文字列バッファ

// Declaration for an SSD1306 display connected to I2C (SDA, SCL pins)
#define OLED_RESET 4  // Reset pin # (or -1 if sharing Arduino reset pin)
Adafruit_SSD1306 display(SCREEN_WIDTH, SCREEN_HEIGHT, &Wire, OLED_RESET);

OneWire oneWire(ONE_WIRE_BUS);  //
DallasTemperature sensors(&oneWire);

/* Assign a unique ID to this sensor at the same time */
Adafruit_ADXL345_Unified accel = Adafruit_ADXL345_Unified(12345);

// 'YFRロゴver', 128x57px
const unsigned char epd_bitmap_YFR__ver[] PROGMEM = {
  0xc0, 0x00, 0x0f, 0xff, 0xff, 0xf0, 0x00, 0x03, 0xff, 0xff, 0xff, 0xff, 0xff, 0xff, 0xff, 0xff,
  0xe0, 0x00, 0x0f, 0xff, 0xff, 0xe0, 0x00, 0x07, 0xff, 0xff, 0xff, 0xff, 0xff, 0xff, 0xff, 0xff,
  0xe0, 0x00, 0x07, 0xff, 0xff, 0xc0, 0x00, 0x0f, 0xff, 0xff, 0xff, 0xff, 0xff, 0xff, 0xff, 0xff,
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  0xff, 0xfc, 0x00, 0x00, 0x7e, 0x00, 0x00, 0x3f, 0xff, 0xff, 0x80, 0x00, 0x00, 0x00, 0x00, 0x7f
};

// Array of all bitmaps for convenience. (Total bytes used to store images in PROGMEM = 928)
const int epd_bitmap_allArray_LEN = 1;
const unsigned char* epd_bitmap_allArray[1] = {
  epd_bitmap_YFR__ver
};

void drawbitmap() {  //ディスプレイにロゴ表示する関数
  display.clearDisplay();
  display.drawBitmap(
    0,
    0,
    epd_bitmap_YFR__ver, BMP_WIDTH, BMP_HEIGHT, 1);
  display.display();
  delay(1000);
}

void displaySensorDetails(void)  //ADXL
{
  sensor_t sensor;
  accel.getSensor(&sensor);
  Serial.println("------------------------------------");
  Serial.print("Sensor:       ");
  Serial.println(sensor.name);
  Serial.print("Driver Ver:   ");
  Serial.println(sensor.version);
  Serial.print("Unique ID:    ");
  Serial.println(sensor.sensor_id);
  Serial.print("Max Value:    ");
  Serial.print(sensor.max_value);
  Serial.println(" m/s^2");
  Serial.print("Min Value:    ");
  Serial.print(sensor.min_value);
  Serial.println(" m/s^2");
  Serial.print("Resolution:   ");
  Serial.print(sensor.resolution);
  Serial.println(" m/s^2");
  Serial.println("------------------------------------");
  Serial.println("");
  delay(500);
}

void displayDataRate(void)  //ADXL
{
  Serial.print("Data Rate:    ");

  switch (accel.getDataRate()) {
    case ADXL345_DATARATE_3200_HZ:
      Serial.print("3200 ");
      break;
    case ADXL345_DATARATE_1600_HZ:
      Serial.print("1600 ");
      break;
    case ADXL345_DATARATE_800_HZ:
      Serial.print("800 ");
      break;
    case ADXL345_DATARATE_400_HZ:
      Serial.print("400 ");
      break;
    case ADXL345_DATARATE_200_HZ:
      Serial.print("200 ");
      break;
    case ADXL345_DATARATE_100_HZ:
      Serial.print("100 ");
      break;
    case ADXL345_DATARATE_50_HZ:
      Serial.print("50 ");
      break;
    case ADXL345_DATARATE_25_HZ:
      Serial.print("25 ");
      break;
    case ADXL345_DATARATE_12_5_HZ:
      Serial.print("12.5 ");
      break;
    case ADXL345_DATARATE_6_25HZ:
      Serial.print("6.25 ");
      break;
    case ADXL345_DATARATE_3_13_HZ:
      Serial.print("3.13 ");
      break;
    case ADXL345_DATARATE_1_56_HZ:
      Serial.print("1.56 ");
      break;
    case ADXL345_DATARATE_0_78_HZ:
      Serial.print("0.78 ");
      break;
    case ADXL345_DATARATE_0_39_HZ:
      Serial.print("0.39 ");
      break;
    case ADXL345_DATARATE_0_20_HZ:
      Serial.print("0.20 ");
      break;
    case ADXL345_DATARATE_0_10_HZ:
      Serial.print("0.10 ");
      break;
    default:
      Serial.print("???? ");
      break;
  }
  Serial.println(" Hz");
}

void displayRange(void)  //ADXL
{
  Serial.print("Range:         +/- ");

  switch (accel.getRange()) {
    case ADXL345_RANGE_16_G:
      Serial.print("16 ");
      break;
    case ADXL345_RANGE_8_G:
      Serial.print("8 ");
      break;
    case ADXL345_RANGE_4_G:
      Serial.print("4 ");
      break;
    case ADXL345_RANGE_2_G:
      Serial.print("2 ");
      break;
    default:
      Serial.print("?? ");
      break;
  }
  Serial.println(" g");
}

// ファイル名が重複しないように、連番を付ける関数
void createUniqueFileName(const int& startIndex, const String& basename, char* filename) {
  int fileIndex = startIndex;
  // "CAN_0.csv", "CAN_1.csv" などの連番を生成し、ファイルが存在しない名前を探す
  do {
    sprintf(filename, "%s_%d.csv",basename.c_str(), fileIndex);
    fileIndex++;
  } while (SD.exists(filename));  // ファイルが存在する限り、ループで次の番号を試す
}

void setup() {
// put your setup code here, to run once:
#ifndef ESP8266
  while (!Serial)
    ;  // for Leonardo/Micro/Zero
#endif
  Serial.begin(9800);  //シリアル通信

  pinMode(9, OUTPUT);   //CAN cs
  pinMode(10, OUTPUT);  //SD cs

  ///////SPI設定
  SPI.setBitOrder(MSBFIRST);            //最上位ビット(MSB)から送信
  SPI.setClockDivider(SPI_CLOCK_DIV4);  //通信速度をデフォルト
  SPI.setDataMode(SPI_MODE2);           //アイドル5Vで0V→5Vの変化で送信する
  SPI.begin();                          //開始
  delay(500);
  ///////SPI設定終わり

  //////CAN通信設定
  if (CAN.begin(MCP_ANY, CAN_500KBPS, MCP_8MHZ) == CAN_OK) {
    CAN.setMode(MCP_NORMAL);
    Serial.println("Can init successfull");
  } else {
    Serial.println("Can init fail");
    while (0)
      ;
  }
  /////CAN通信設定終わり

  /////SDcard設定
  Serial.print("Initializing SD card...");

  if (!SD.begin(9)) {
    Serial.println("initialization failed!");
    while (1)
      ;
  }
  // 最初のファイル名を設定 (例: CAN_0.csv)
  int fileIndex = 0;  // 最初のファイル番号
  createUniqueFileName(fileIndex);

  // ファイルを開く（新規作成）
  myFile = SD.open(fileName_can, FILE_WRITE);
  if (myFile) {
    // ヘッダーを書き込む
    myFile.println("Status,Revolution[rpm],Speed[m/s],Voltage[V],Current[Arms],Error");
    myFile.close();
  } else {
    Serial.println("Error creating file!");
  }

  Serial.println("initialization done.");
  //////SDcard設定終わり

  /////ADXL設定
  Serial.println("Accelerometer Test");
  Serial.println("");

  // Initialise the sensor
  if (!accel.begin()) {
    //There was a problem detecting the ADXL345 ... check your connections
    Serial.println("Ooops, no ADXL345 detected ... Check your wiring!");
    while (1)
      ;
  }

  // Set the range to whatever is appropriate for your project
  accel.setRange(ADXL345_RANGE_16_G);
  // accel.setRange(ADXL345_RANGE_8_G);
  // accel.setRange(ADXL345_RANGE_4_G);
  // accel.setRange(ADXL345_RANGE_2_G);

  // Display some basic information on this sensor
  displaySensorDetails();

  // Display additional settings (outside the scope of sensor_t)
  displayDataRate();
  displayRange();
  Serial.println("");
  /////ADXL設定終わり

  sensors.setResolution(SENSER_BIT);  //DS18B20設定

  //////ディスプレイ設定
  display.begin(SSD1306_SWITCHCAPVCC, 0x3C);  // initialize with the I2C addr 0x3D (for the 128x64)
  display.clearDisplay();

  // text display tests
  drawbitmap();

  display.display();
  delay(5000);
  display.clearDisplay();
  display.display();
  //////ディスプレイ設定終わり
}

void loop() {
  /////宣言
  unsigned long id;  //id
  byte len;          //フレームの長さ
  byte buf_r[8];     //can通信受信バッファ
  static unsigned short Op_status;
  unsigned short Motor_cur;
  unsigned short Anomaly_sig;
  short Motor_rev;  //モーター回転数
  short Speed;      //速度
  short Motor_V;    //モーター相電圧
  /////宣言終わり

  /////can通信
  if (CAN.checkReceive() == CAN_MSGAVAIL) {
    CAN.readMsgBuf(&id, &len, buf_r);
    if (id = 0x311)  //ID:785
    {
      //制御状態
      Op_status = buf_r[0];
      for (int n = 6; n < 8; n++) {
        bitClear(Op_status, n);  //LSBから6-7ビット目を「0」ビットにする
      }
      Op_status = Op_status >> 3;

      //モーター速度[m/m]
      Motor_rev = (buf_r[2] << 8) | buf_r[1];
      Motor_rev = Motor_rev - 14000;  //モーター回転数
      Speed = Motor_rev * PI * tiya;  //速度（まだまだ）
      //Serial.print("Speed:");Serial.print(Speed);Serial.println("[m/m]");

      //モーター相電圧[V]
      Motor_V = (buf_r[5] << 8) | buf_r[4];
      for (int i = 12; i < 16; i++) {
        bitClear(Motor_V, i);
      }
      Motor_V = Motor_V >> 2;
      //Serial.print("モーター電圧:");Serial.print(Motor_V);Serial.println("[V]");

      //モーター相電流
      Motor_cur = (buf_r[4] << 8) | buf_r[3];
      for (int m = 10; m < 16; m++) {
        bitClear(Motor_cur, m);
      }
      Motor_cur = Motor_cur * 0.5;

      //異常状態 信号
      Anomaly_sig = buf_r[7] >> 5;
    }
  }

  ////SDカードにCANのデータを記録(CAN.csv)
  myFile = SD.open("CAN.csv", FILE_WRITE);

  if (myFile) {
    Serial.print("Writing to test.txt...");

    // ヘッダー
    myFile.println("Status,Revolution[rpm],Speed[m/s],Voltage[V],Current[Arms],Error");

    //制御状態

    if (Op_status == B000) {
      myFile.print("init");  //init
    } else if (Op_status == B001) {
      myFile.print("Precharge");  //Precharge
    } else if (Op_status == B010) {
      myFile.print("Standby");  //Standby
    } else if (Op_status == B011) {
      myFile.print("Troque Contorol");  //Torque control
    } else if (Op_status == B111) {
      myFile.print("Rapid Discharge");  //Rapid discharge
    } else {
      myFile.print("--");  //--:Reserved
    }
    myFile.print(",");  //カンマ

    //モータ回転数
    myFile.print(Motor_rev);
    myFile.print(",");

    //モーター速度
    myFile.print(Speed);
    myFile.print(",");

    //モーター相電圧
    myFile.print(Motor_V);
    myFile.print(",");

    //モーター相電流
    mmyFile.print(Motor_cur);
    myFile.print(",");

    //異常信号
    if (Anomaly_sig == B000) {
      myFile.print("No Error");
    } else if (Anomaly_sig == B001) {
      myFile.print("power limit");  //derating, モータ出力制限
    } else if (Anomaly_sig == B010) {
      myFile.print("Warning");
    } else if (Anomaly_sig == B100) {
      myFile.print("Error");
    } else if (Anomaly_sig == B101) {
      myFile.print("Critical Error");
    } else {
      myFile.print("--");  //--:Reserved
    }

    myFile.println("");  //行の最後は改行

    // close the file:
    myFile.close();
    Serial.println("done.");
  } else {
    // if the file didn't open, print an error:
    Serial.println("error opening csv file");
  }
  //記録終わり

  ////温度センサー
  sensors.requestTemperatures();  //センサーから温度データを取得
  Serial.print("temperture:");
  Serial.println(sensors.getTempCByIndex(0));  //取得した温度データを表示
  /* Get a new sensor event */
  sensors_event_t event;
  accel.getEvent(&event);

  short tem;
  tem = sensors.getTempCByIndex(0);
  //SDカードに冷却水温度を記録(tem.txt)
  myFile = SD.open("tem.csv", FILE_WRITE);

  if (myFile) {
    Serial.print("Writing to tem.csv...");

    // ヘッダー
    myFile.println("tem");

    // 記録
    myFile.print(tem);
    myFile.println();

    // close the file:
    myFile.close();
    Serial.println("done.");
  } else {
    // if the file didn't open, print an error:
    Serial.println("error opening csv file");
  }
  //温度センサー終わり

  ////加速度センサー
  /* Display the results (acceleration is measured in m/s^2) */
  Serial.print("X: ");
  Serial.print(event.acceleration.x);
  Serial.print("  ");
  Serial.print("Y: ");
  Serial.print(event.acceleration.y);
  Serial.print("  ");
  Serial.print("Z: ");
  Serial.print(event.acceleration.z);
  Serial.print("  ");
  Serial.println("m/s^2 ");
  //加速度センサー終わり

  ////ディスプレイ表示
  display.setTextSize(3);
  display.setTextColor(WHITE);
  display.setCursor(0, 0);
  display.print("Motor:");
  display.print(Motor_rev);
  display.println("[rpm]");
  display.print("Speed:");
  display.print(Speed);
  display.println("[m/m]");
  display.print("Vol:");
  display.print(Motor_V);
  display.println("[V]");

  display.display();
  delay(100);
  display.clearDisplay();
  display.display();
  //ディスプレイ表示終わり
  delay(1000);
}
